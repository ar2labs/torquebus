VERSION "1.0"

NS_ :

BS_:

BU_: ECM ECU

BO_ 1 EngineSpeed: 8 ECU
 SG_ RPM : 0|16@1+ (0.125,0) [0|8191.875] "rpm" ECM

BO_ 255 Temperature: 8 ECU
 SG_ CoolantTemp : 0|8@1+ (1,-40) [-40|215] "degC" ECM

CM_ "Standard 11-bit CAN communication matrix for the TorqueBus Studio powertrain actuator ECU example (examples/scripts/ecu_motor.lua and examples/projects/virtual-vehicle.tbsproj).";
CM_ BU_ ECM "Engine Control Module / Instrument Cluster receiving engine speed and coolant temperature.";
CM_ BU_ ECU "Powertrain Actuator Electronic Control Unit transmitting engine speed (0x001) and coolant temperature (0x0FF).";

CM_ BO_ 1 "CAN ID 0x001 (1) - EngineSpeed. Transmitted by ECU every 500 ms (2 Hz). Carries 16-bit engine rotational speed in rpm.";
CM_ BO_ 255 "CAN ID 0x0FF (255) - Temperature. Transmitted by ECU every 1000 ms (1 Hz). Carries 8-bit engine coolant temperature with -40 degC offset.";

CM_ SG_ 1 RPM "Engine crankshaft rotational speed (uint16 little-endian, 0.125 rpm per bit, offset 0, range 0 to 8191.875 rpm).";
CM_ SG_ 255 CoolantTemp "Engine coolant temperature (uint8, 1 degC per bit, offset -40 degC, range -40 to 215 degC; e.g. 85 degC = raw 125 = 0x7D).";

BA_DEF_  "BusType" STRING ;
BA_DEF_  "DBName" STRING ;
BA_DEF_ BO_  "GenMsgCycleTime" INT 0 3600000;
BA_DEF_ BO_  "VFrameFormat" ENUM  "StandardCAN","ExtendedCAN","reserved","J1939PG","reserved","reserved","reserved","reserved","reserved","reserved","reserved","reserved","reserved","reserved","StandardCAN_FD","ExtendedCAN_FD";
BA_DEF_DEF_  "BusType" "CAN";
BA_DEF_DEF_  "DBName" "";
BA_DEF_DEF_  "GenMsgCycleTime" 0;
BA_DEF_DEF_  "VFrameFormat" "StandardCAN";
BA_ "DBName" "ecu";
BA_ "GenMsgCycleTime" BO_ 1 500;
BA_ "GenMsgCycleTime" BO_ 255 1000;
